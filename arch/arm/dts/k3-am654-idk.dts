// SPDX-License-Identifier: GPL-2.0
/*
 * DT overlay for IDK application board on AM654 EVM (SR2.0)
 *
 * Copyright (C) 2020-2021 Texas Instruments Incorporated - https://www.ti.com/
 */

/dts-v1/;
/plugin/;

/ {
	fragment@101 {
		target-path = "/";
	};
};

