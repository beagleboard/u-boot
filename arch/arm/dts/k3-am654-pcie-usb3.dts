// SPDX-License-Identifier: GPL-2.0
/**
 * DT overlay for SERDES personality card: 1lane PCIe + USB3.0 DRD on AM654 EVM
 *
 * Copyright (C) 2020 Texas Instruments Incorporated - http://www.ti.com/
 */

/dts-v1/;
/plugin/;
/ {
	fragment@101 {
		target-path = "/";
	};
};

