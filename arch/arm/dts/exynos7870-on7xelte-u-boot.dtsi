// SPDX-License-Identifier: GPL-2.0
/*
 * Copyright (c) 2026 Kaustabh Chakraborty <kauschluss@disroot.org>
 */

/ {
	chosen {
		#address-cells = <2>;
		#size-cells = <1>;
		ranges;

		framebuffer@67000000 {
			compatible = "simple-framebuffer";
			reg = <0x0 0x67000000 (1080 * 1920 * 4)>;
			width = <1080>;
			height = <1920>;
			stride = <(1080 * 4)>;
			format = "a8r8g8b8";
		};
	};
};
