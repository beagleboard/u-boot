// SPDX-License-Identifier: GPL-2.0
/**
 * DT overlay for HSE NAND expansion card on AM642 EVM
 *
 * Copyright (C) 2021 Texas Instruments Incorporated - https://www.ti.com/
 */

/dts-v1/;
/plugin/;
#include <dt-bindings/gpio/gpio.h>
#include <dt-bindings/interrupt-controller/irq.h>
#include <dt-bindings/pinctrl/k3.h>

#include "k3-am642-evm-nand.dtsi"
