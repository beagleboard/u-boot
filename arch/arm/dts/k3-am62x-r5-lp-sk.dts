// SPDX-License-Identifier: GPL-2.0
/*
 * AM62x LP SK dts file for R5 SPL
 * Copyright (C) 2021-2022 Texas Instruments Incorporated - https://www.ti.com/
 */

#include "k3-am62x-lp-sk.dts"
#include "k3-am62x-ddr-lp4-50-800-800.dtsi"
#include "k3-am62-ddr.dtsi"

#include "k3-am62x-lp-sk-u-boot.dtsi"
#include "k3-am62x-r5-sk-common.dtsi"
