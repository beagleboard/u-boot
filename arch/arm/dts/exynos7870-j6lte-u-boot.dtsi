// SPDX-License-Identifier: GPL-2.0
/*
 * Copyright (c) Kaustabh Chakraborty <kauschluss@disroot.org>
 */

/ {
	chosen {
		#address-cells = <2>;
		#size-cells = <1>;
		ranges;

		framebuffer@67000000 {
			compatible = "simple-framebuffer";
			reg = <0x0 0x67000000 (720 * 1480 * 4)>;
			width = <720>;
			height = <1480>;
			stride = <(720 * 4)>;
			format = "a8r8g8b8";
		};
	};
};
